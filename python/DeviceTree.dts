&mdss_mdp {
	dsi_truly_ips3p3097_e_r63315_1080p_video: qcom,mdss_dsi_truly_ips3p3097_e_r63315_1080p_video {
		qcom,mdss-dsi-panel-name = "r63315 1080p video mode dsi panel";
		qcom,mdss-dsi-panel-controller = <&mdss_dsi0>;
		qcom,mdss-dsi-panel-type = "dsi_video_mode";
		qcom,mdss-dsi-panel-destination = "display_1";
		qcom,mdss-dsi-panel-framerate = <60>;
		qcom,mdss-dsi-virtual-channel-id = <0>;
		qcom,mdss-dsi-stream = <0>;
		qcom,mdss-dsi-panel-width = <1080>;
		qcom,mdss-dsi-panel-height = <1920>;
		qcom,mdss-dsi-h-front-porch = <90>;
		qcom,mdss-dsi-h-back-porch = <60>;
		qcom,mdss-dsi-h-pulse-width = <20>;
		qcom,mdss-dsi-h-sync-skew = <0>;
		qcom,mdss-dsi-v-back-porch = <4>;
		qcom,mdss-dsi-v-front-porch = <8>;
		qcom,mdss-dsi-v-pulse-width = <2>;
		qcom,mdss-dsi-h-left-border = <0>;
		qcom,mdss-dsi-h-right-border = <0>;
		qcom,mdss-dsi-v-top-border = <0>;
		qcom,mdss-dsi-v-bottom-border = <0>;
		qcom,mdss-dsi-bpp = <24>;
		qcom,mdss-dsi-color-order = <0>;
		qcom,mdss-dsi-underflow-color = <0xff>;
		qcom,mdss-dsi-border-color = <0>;
		qcom,cont-splash-enabled = <1>;
		qcom,mdss-dsi-pixel-packing = "tight";
		qcom,mdss-dsi-on-command = [39 01 00 00 c8 00 02 11 00
		29 01 00 00 00 00 02 B0 04
		29 01 00 00 00 00 02 D6 01
		29 01 00 00 00 00 07 B3 14 00 00 00 00 00
		29 01 00 00 00 00 03 B6 3A C3
		29 01 00 00 00 00 02 C0 00
		29 01 00 00 00 00 23 C1 84 60 10 EB FF 6F CE FF FF 17 12 58 73 AE 31 20 C6 FF FF 1F F3 FF 5F 10 10 10 10 00 62 01 22 22 00 01
		29 01 00 00 00 00 08 C2 31 F7 80 06 08 80 00
		29 01 00 00 00 00 17 C4 70 00 00 00 00 00 00 00 00 0C 06 00 00 00 00 00 00 00 00 00 0C 06
		29 01 00 00 00 00 29 C6 C8 08 67 08 67 00 00 00 00 00 00 00 00 00 00 00 00 16 18 08 C8 08 67 08 67 00 00 00 00 00 00 00 00 00 00 00 00 16 18 08
		29 01 00 00 00 00 1F C7 00 10 1F 20 2C 38 42 50 34 3C 4C 5D 68 6D 71 00 10 1F 20 2C 38 42 50 34 3C 4C 5D 68 6D 71
		29 01 00 00 00 00 14 C8 00 00 00 00 00 FC 00 00 00 00 00 FC 00 00 00 00 00 FC 00
		29 01 00 00 00 00 09 CB 31 FC 3F 8C 00 00 00 00
		29 01 00 00 00 00 02 CC 0B
		29 01 00 00 00 00 0B D0 11 81 BB 19 99 4C 19 19 0C 00
		29 01 00 00 00 00 1A D3 1B 33 BB BB B3 33 33 33 01 01 00 A0 D8 A0 0D 48 48 44 3B 22 72 07 3D BF 33
		29 01 00 00 00 00 08 D5 06 00 00 01 42 01 42
		29 01 00 00 00 00 08 D5 06 00 00 01 42 01 42
		39 01 00 00 00 00 02 51 00
		39 01 00 00 00 00 02 53 2C
		39 01 00 00 00 00 02 55 01
		39 01 00 00 00 00 02 5E 80
		39 01 00 00 00 00 02 36 C0
		39 01 00 00 c8 00 02 29 00];
		qcom,mdss-dsi-off-command = [
		39 01 00 00 00 00 02 53 00
		39 01 00 00 00 00 02 53 00
		29 01 00 00 00 00 08 D5 06 00 00 00 48 00 48
		29 01 00 00 00 00 08 D5 06 00 00 00 48 00 48
		39 01 00 00 0A 00 02 28 00
		39 01 00 00 96 00 02 10 00];
		qcom,mdss-dsi-on-command-state = "dsi_lp_mode";
		qcom,mdss-dsi-off-command-state = "dsi_lp_mode";
		qcom,mdss-dsi-h-sync-pulse = <1>;
		qcom,mdss-dsi-traffic-mode = <2>;
		qcom,mdss-dsi-lane-map = <0>;
		qcom,mdss-dsi-bllp-eof-power-mode;
		qcom,mdss-dsi-bllp-power-mode;
		qcom,mdss-dsi-lane-0-state;
		qcom,mdss-dsi-lane-1-state;
		qcom,mdss-dsi-lane-2-state;
		qcom,mdss-dsi-lane-3-state;
		qcom,mdss-dsi-panel-timings = [5F 36 24 00 66 6A 2A 3A 2D 03 04 00];
		qcom,mdss-dsi-t-clk-post = <0x1e>;
		qcom,mdss-dsi-t-clk-pre = <0x38>;
		qcom,mdss-dsi-bl-min-level = <1>;
//[SIMT-szhaojun-20140610]Update lcd max backlight level from 255 to 200
		qcom,mdss-dsi-bl-max-level = <200>;
//[SIMT-szhaojun-20140610]
		qcom,mdss-dsi-dma-trigger = <4>;
		qcom,mdss-dsi-mdp-trigger = <0>;
		qcom,mdss-dsi-bl-pmic-control-type = "bl_ctrl_dcs";
		qcom,mdss-dsi-reset-sequence = <1 20>, <0 15>, <1 20>;
	};
};
